## app/project/Kconfig
```kconfig
#Kconfig root for APP.
source "$SIFLI_SDK/Kconfig.v2"
rsource "Kconfig.proj"
config PA_EN_PIN
    int "PA Enable Pin"
    default 10  # 也可以不设默认值，由 proj.conf 赋值
    help
        Pin number for PA (Power Amplifier) enable.
```

## app/project/Kconfig.tmp
```kconfig
source "G:/Desktop/ProjectJamal/SF32_GITEE/xiaozhi-sf32-lei2/xiaozhi-sf32-lei2/app/boards/sf32lb52-xty-ai-tht/hcpu/Kconfig.board"
source "$SIFLI_SDK/customer/boards/Kconfig.v2"
source "$SIFLI_SDK/Kconfig.v2"
rsource "Kconfig.proj"
```
